/*
 * pwm-gpio12to15-pi5-overlay.dts
 */

/dts-v1/;
/plugin/;

//#include <dt-bindings/gpio/gpio.h>
//#include <dt-bindings/leds/common.h>

/ {
	compatible = "brcm,bcm2712";

	fragment@0 {
		target = <&rp1_gpio>;
		__overlay__ {
			pwm_pins: pwm_pins {
				pins = "gpio12", "gpio13", "gpio14", "gpio15";
				function = "pwm0", "pwm0", "pwm0", "pwm0";
			};
		};
	};

	fragment@1 {
		target = <&rp1_pwm0>;
		frag1: __overlay__ {
			pinctrl-names = "default";
			pinctrl-0 = <&pwm_pins>;
			/* in Hz */
			/* Max supported frequency is 50MHz */
			assigned-clock-rates = <40000000>;
			status = "okay";
		};
	};
};